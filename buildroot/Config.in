## buildroot/Config.in
```kconfig
config BR2_PACKAGE_HTTPFS
	bool "httpfs"
	depends on BR2_USE_WCHAR
	depends on BR2_TOOLCHAIN_HAS_THREADS
	depends on BR2_USE_MMU
	depends on BR2_PACKAGE_LIBFUSE
	help
	  http filesystem support using fuse

comment "httpfs needs a toolchain w/ wchar, threads"
	depends on BR2_USE_MMU
	depends on !BR2_USE_WCHAR || !BR2_TOOLCHAIN_HAS_THREADS
```
